## components/kvs_webrtc/Kconfig.projbuild
```kconfig
menu "KVS WebRTC Configuration"

    config ENABLE_DATA_CHANNEL
        bool "Enable Data channel support using usrsctp"
        default y
        help
            Enables WebRTC Data channel support

    config USE_ESP_TLS_FOR_KVS
        bool "Use ESP-TLS for KVS TLS connections (TURN over TLS)"
        default y
        help
            Use ESP-TLS implementation instead of direct mbedTLS for TLS connections.
            This enables the use of ESP certificate bundle for CA verification,
            eliminating the need for certificate files on the filesystem.
            Recommended for ESP platforms to avoid certificate management complexity.

    config KVS_WEBRTC_ICE_TRANSPORT_RELAY_ONLY
        bool "Force ICE transport policy to RELAY only (use TURN exclusively)"
        default n
        help
            Force the ICE Agent to use TURN relay candidates only — host and
            srflx candidates are not advertised. This is required when the
            device is behind a one-way NAT that the remote peer cannot
            reach back into (e.g. qemu-xtensa user-mode networking / slirp,
            CGNAT on cellular). Both peers then connect through the AWS TURN
            relay, which only needs outbound connectivity from each side.

            Set this with `CONFIG_KVS_WEBRTC_ICE_TRANSPORT_RELAY_ONLY=y` in
            sdkconfig.defaults.qemu (or any deployment overlay where host
            candidates are unreachable from the remote peer's perspective).

            Default: n (ICE_TRANSPORT_POLICY_ALL — host + srflx + relay).
endmenu
```

## examples/webrtc_classic/main/Kconfig.projbuild
```kconfig
menu "WebRTC Classic example"

    config APP_VIDEO_USE_FILE_FRAMES
        bool "Stream sample H.264 frames from SPIFFS instead of camera"
        default n
        help
            On real ESP hardware, webrtc_classic captures live frames from
            the camera (and audio from the mic). For QEMU runs there's
            neither — instead loop through /spiffs/samples/frame-*.h264
            (and the matching Opus frames) via media_stream's
            file-based capture interface. Same WebRTC pipeline, just a
            different frame source.

            Default off; the docker integration test enables this via
            sdkconfig.defaults.qemu so the QEMU master actually has
            something to send to the Python viewer.

endmenu
```

## examples/webrtc_classic/sdkconfig.defaults.p4_eye
```kconfig
CONFIG_PARTITION_TABLE_CUSTOM=y

#
# Chip revision
#
CONFIG_ESP32P4_SELECTS_REV_LESS_V3=y
CONFIG_ESP32P4_REV_MIN_0=y

#
# Slave Flasher
#
CONFIG_SLAVE_FLASHER_ENABLE=y
CONFIG_SLAVE_PARTITION_TABLE_ADDRESS=0xC000
CONFIG_SLAVE_APPLICATION_ADDRESS=0x20000
CONFIG_SLAVE_UART_RX_PIN=36
CONFIG_SLAVE_UART_TX_PIN=35
CONFIG_SLAVE_GPIO0_TRIGGER_PIN=33
```
